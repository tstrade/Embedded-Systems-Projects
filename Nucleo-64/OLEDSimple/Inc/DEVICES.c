#include <DEVICES.h>
#include <STM32_util.h>

unsigned char asciiChar[]= {
	0x00, 0x00, 0x00, 0x00, 0x00,
	0x3E, 0x5B, 0x4F, 0x5B, 0x3E,
	0x3E, 0x6B, 0x4F, 0x6B, 0x3E,
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	0x00, 0x00, 0x00, 0x00, 0x00
};

void  ssd1306_command(unsigned char c)
{
	unsigned char control = 0x00;

    I2C2WriteRegister(OLED_addr, control, c);
    }

void  ssd1306_data(unsigned char c)
{
   I2C2WriteRegister(OLED_addr, 0x40, c);

}
void setColAddress(int xCol)
{
	if(xCol>(SSD1306_LCDWIDTH-1))return;
  ssd1306_command(SSD1306_COLUMNADDR);
  ssd1306_command(xCol);
  ssd1306_command(SSD1306_LCDWIDTH-1);
}

void setPageAddress(int yPage)
{  if(yPage>(SSD1306_LCDHEIGHT/8-1))return;
  ssd1306_command(SSD1306_PAGEADDR);
  ssd1306_command(yPage);
  ssd1306_command((SSD1306_LCDHEIGHT/8)-1);
}

void transferBuffer(int *p, int size,unsigned char xCol,unsigned char yPage)
{
	int j=0;
      setColAddress(xCol);
      setPageAddress(yPage);

      for(j=0;j<size;j++)
      {
        I2C2WriteRegister(OLED_addr, 0x40, *p);
        p++;
      }
}

#define CHAR_MODE 0
#define GRAPHICS_Mode 1

void Init_OLED(int mode)
{
	Init_I2C2(400000);
    ssd1306_command(SSD1306_DISPLAYOFF);
    ssd1306_command(SSD1306_SETDISPLAYCLOCKDIV);
    ssd1306_command(0x80);
    ssd1306_command(SSD1306_SETMULTIPLEX);
    ssd1306_command(0x3F);
    ssd1306_command(SSD1306_SETDISPLAYOFFSET);
    ssd1306_command(0x0);
    ssd1306_command(SSD1306_SETSTARTLINE);
    ssd1306_command(SSD1306_CHARGEPUMP);
    ssd1306_command(0x14);
    ssd1306_command(SSD1306_MEMORYMODE);
    ssd1306_command(0x00);
    ssd1306_command(SSD1306_SEGREMAP | 0x1);
    ssd1306_command(SSD1306_COMSCANDEC);
    ssd1306_command(SSD1306_SETCOMPINS);
    ssd1306_command(0x12);
    ssd1306_command(SSD1306_SETCONTRAST);
    ssd1306_command(0xCF);
    ssd1306_command(SSD1306_SETPRECHARGE);
    ssd1306_command(0xF1);
    ssd1306_command(SSD1306_SETVCOMDETECT);
    ssd1306_command(0x40);
    ssd1306_command(SSD1306_DISPLAYALLON_RESUME);
    ssd1306_command(SSD1306_NORMALDISPLAY);
    ssd1306_command(SSD1306_DISPLAYON);
}

void Clear_OLED(void)
{	int j=0;
      setColAddress(0);
      setPageAddress(0);

      for(j=0;j<1024;j++)
        I2C2WriteRegister(OLED_addr, 0x40, 0);
}

void Set_Cursor_Pos(int pixel, int row){
	      setColAddress(pixel);
	      setPageAddress(row);
	      }

void PrintChar_OLED(char ascii_x)

{
	int j,calc_Array_Index;
      calc_Array_Index= 5 * ascii_x;
      I2C2WriteRegister(OLED_addr, 0x40, 0);
      for(j=0;j<5;j++)
      {
        I2C2WriteRegister(OLED_addr, 0x40, asciiChar[calc_Array_Index]);
        calc_Array_Index++;
      }
      I2C2WriteRegister(OLED_addr, 0x40, 0);
}

void WriteString_OLED(char *str)
{	while (*str)
	{
	  PrintChar_OLED(*str);
	  str++;
	}
}

void Draw_segm_OLED(int d)
{
     I2C2WriteRegister(OLED_addr, 0x40, d);
}




